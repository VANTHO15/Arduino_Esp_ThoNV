#include "Lcd1202.h"

Lcd1202 display(2, 0, 4, 5); 

const uint8_t earth[] PROGMEM = {
0x00, 0x00, 0x00, 0x00, 0x00, 0x00, 0x00, 0x00, 0x00, 0x00, 0x00, 0x00, 0x00, 0x00, 0x00, 0x00,
0x00, 0x00, 0x00, 0x00, 0x00, 0x00, 0x00, 0x00, 0x00, 0x00, 0x00, 0x00, 0x00, 0x00, 0x00, 0x00,
0x00, 0x00, 0x00, 0x00, 0x00, 0x00, 0x00, 0x00, 0x00, 0x00, 0x00, 0x00, 0x00, 0x00, 0x00, 0x00,
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0x00, 0x00, 0x00, 0x00, 0x00, 0x00, 0x00, 0x00, 0x00, 0x00, 0x00, 0x00, 0x00, 0x00, 0x00, 0x00
};

const uint8_t qrcode[] PROGMEM = {
0xFF, 0xFF, 0x03, 0x03, 0xF3, 0xF3, 0xF3, 0xF3, 0xF3, 0xF3, 0x03, 0x03, 0xFF, 0xFF, 0x00, 0x00,
0xCC, 0xCC, 0x3F, 0x3F, 0xFC, 0xFC, 0xF3, 0xF3, 0xF0, 0xF0, 0xCC, 0xCC, 0xC0, 0xC0, 0xFC, 0xFC,
0xFF, 0xFF, 0x00, 0x00, 0xFF, 0xFF, 0x03, 0x03, 0xF3, 0xF3, 0xF3, 0xF3, 0xF3, 0xF3, 0x03, 0x03,
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0x03, 0x03, 0x03, 0x03, 0x03, 0x03, 0x03, 0x03, 
};

int nFrames = 36;

void setup() {
  display.init();
  display.clear();
  display.display();

  delay(500);
  
  testRotate();  
  testDrawPixel();
  testDrawRect();
  testFillRect();
  testDrawCircle();
  
  testFillCircle();
  testDrawRoundRect();
  testFillRoundRect();
  testDrawTriangle();
  testFillTriangle();

  printBuffer();
  testDrawBitmap();
}

void loop() {
}

void testDrawPixel(void) {
  display.clear();
  
  display.setColor(BLACK);
  
    for(int16_t i=0; i<display.width(); i++) {
      for(int16_t j=0; j<display.height(); j+=2) {
        display.setPixel(i, j);
      }
      display.display();
      delay(1);
    }
    
    for(int16_t i=display.width()-1; i>=0; i--) {
      for(int16_t j=display.height()-1; j>=0; j-=2) {
        display.setPixel(i, j);
      }
      display.display();
      delay(1);
    }

  display.setColor(WHITE);
  
    for(int16_t i=0; i<display.width(); i++) {
      for(int16_t j=0; j<display.height(); j+=2) {
        display.setPixel(i, j);
      }
      display.display();
      delay(1);
    }
    
    for(int16_t i=display.width()-1; i>=0; i--) {
      for(int16_t j=display.height()-1; j>=0; j-=2) {
        display.setPixel(i, j);
      }
      display.display();
      delay(1);
    }
    
    display.setColor(BLACK);
    delay(500);
}

void testDrawRect(void) {
  display.clear();

  display.setColor(BLACK);
  
  for(int16_t i=0; i<display.height()/2; i+=2) {
    display.drawRect(i, i, display.width()-2*i, display.height()-2*i);
    display.display();
    delay(1);
  }

  delay(500);
}

void testFillRect(void) {
  display.clear();

  display.setColor(INVERSE);
  
  for(int16_t i=0; i<display.height()/2; i+=3) {
    display.fillRect(i, i, display.width()-i*2, display.height()-i*2);
    display.display();
    delay(1);
  }

  delay(500);
}

void testDrawCircle(void) {
  display.clear();

  display.setColor(BLACK);
    
  for(int16_t i=0; i<max(display.width(),display.height())/2; i+=2) {
    display.drawCircle(display.width()/2, display.height()/2, i);
    display.display();
    delay(1);
  }

  delay(500);
}

void testFillCircle(void) {
  display.clear();

  display.setColor(INVERSE);
  
  for(int16_t i=max(display.width(),display.height())/2; i>0; i-=3) {
    display.fillCircle(display.width() / 2, display.height() / 2, i);
    display.display();
    delay(2);
  }
  
  delay(500);
}

void testDrawRoundRect(void) {
  display.clear();

  display.setColor(BLACK);
  
  for(int16_t i=0; i<display.height()/2-2; i+=2) {
    display.drawRoundRect(i, i, display.width()-2*i, display.height()-2*i, display.height()/4);
    display.display();
    delay(1);
  }

  delay(500);
}

void testFillRoundRect(void) {
  display.clear();

  display.setColor(INVERSE);
  
  for(int16_t i=0; i<display.height()/2-2; i+=2) {
    display.fillRoundRect(i, i, display.width()-2*i, display.height()-2*i, display.height()/4);
    display.display();
    delay(1);
  }

  delay(500);
}

void testDrawTriangle(void) {
  display.clear();

  display.setColor(BLACK);
  
  for(int16_t i=0; i<max(display.width(),display.height())/2; i+=5) {
    display.drawTriangle(
      display.width()/2  , display.height()/2-i,
      display.width()/2-i, display.height()/2+i,
      display.width()/2+i, display.height()/2+i);
    display.display();
    delay(1);
  }

  delay(500);
}

void testFillTriangle(void) {
  display.clear();

  display.setColor(INVERSE);
  
  for(int16_t i=max(display.width(),display.height())/2; i>0; i-=5) {
    display.fillTriangle(
      display.width()/2  , display.height()/2-i,
      display.width()/2-i, display.height()/2+i,
      display.width()/2+i, display.height()/2+i);
    display.display();
    delay(1);
  }
  delay(500);
}

void testDrawBitmap(void) {
  display.clear();
  display.drawBitmap(23, 9, 50, 50, qrcode);
  display.display();
  delay(2000);

  display.invertDisplay();
  delay(500);
  display.invertDisplay();
  delay(500);
  display.invertDisplay();
  delay(500);
  display.invertDisplay();
  delay(500);

  while(1) {
    for(int i=0; i< 95; i++) {
      display.clear();
      display.drawBitmap(i, 0, display.width(), display.height()-4, earth);
      display.drawBitmap(i-95, 0, display.width(), display.height()-4, earth);
      display.display();
      delay(50);
    }
  }
}

void printBuffer(void) {
  // Initialize the log buffer
  // allocate memory to store 8 lines of text and 30 chars per line.
  display.setLogBuffer(5, 30);

  // Some test data
  const char* test[] = {
      "Hello",
      "World" ,
      "----",
      "Show off",
      "how",
      "the log buffer",
      "is",
      "working.",
      "Even",
      "scrolling is",
      "working"
  };

  for (uint8_t i = 0; i < 11; i++) {
    display.clear();
    // Print to the screen
    display.println(test[i]);
    // Draw it to the internal screen buffer
    display.drawLogBuffer(0, 0);
    // Display it on the screen
    display.display();
    delay(300);
  }
  delay(500);
}

void Rotate(int frame)
{
  display.clear();
  
  int n = 7;
  int r = frame * 48 / nFrames;
  float rot = frame * 2*PI / nFrames;
  for (int i=0; i<(n-1); i++)
  {
    float a = rot + i * 2*PI / n;
    int x1 = 48 + cos(a) * r;
    int y1 = 32 + sin(a) * r;
    for (int j=i+1; j<n; j++)
    {
      a = rot + j * 2*PI / n;
      int x2 = 48 + cos(a) * r;
      int y2 = 32 + sin(a) * r;
      display.drawLine(x1,y1, x2,y2);
    }
    delay(5);
  }
  display.display();
}

void testRotate(void) {
  display.setColor(BLACK);
  
  for (int frame=0; frame < nFrames; frame++) {
    Rotate(frame);
  }

  for (int frame=(nFrames-1); frame >= 0; frame--) {
    Rotate(frame);
  }

  delay(500);
}
